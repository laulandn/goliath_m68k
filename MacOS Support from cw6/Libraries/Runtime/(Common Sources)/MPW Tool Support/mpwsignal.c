/*
*
*	mpwsignal.c
*	Copyright 1995-1997 Metrowerks, Inc. All rights reserved.
*
*	support for calling the CW ANSI libs from CW MPW tools
*
*	The ANSI libs have the following copyright notice.  
*	Copyright (c) 1994 by P.J. Plauger.  ALL RIGHTS RESERVED. 
*	Consult your license regarding permissions and restrictions.
*
*/

#if !defined(Using_StdCLib)

#include <signal.h>
#include <errno.h>

#define MPWSIG_DFL ((void (*)(int)) 1)
#define MPWSIG_ERR ((void (*)(int)) -1)
#define MPWSIG_IGN ((void (*)(int)) 0)
#define MPWSIG_HOLD ((void (*)(int)) 3)
#define MPWSIG_RELEASE ((void (*)(int)) 5)


/*
 *	Signal numbers for specific conditions.
 */

#define MPWSIGABRT		(1<<0)	/* Abnormal termination e.g. by the abort() function */
#define MPWSIGINT		(1<<1)	/* Interactive attention signal -- User interrupt via CMD-. */
#define MPWSIGFPE		(1<<2)	/* Arithmetic exception -- not currently implemented */
#define MPWSIGILL		(1<<3)	/* Illegal instruction -- not currently implemented */
#define MPWSIGSEGV		(1<<4)	/* Segmentation violation -- not currently implemented */
#define MPWSIGTERM		(1<<5)	/* Termination request -- not currently implemented */

/* routine call MPW's signal (renamed to _signal) */
#ifndef __MODENALIB__	/*plauger*/
#if defined(powerc)
	extern _Sigfun *(*_signal)(long sig, _Sigfun *fun);
	extern long *_mpwerrno;
	#define GetMPWerrno() *_mpwerrno
#else
	#pragma segment Main
	extern _Sigfun *(_signal)(long sig, _Sigfun *fun);
	extern long _mpwerrno;
	#define GetMPWerrno() _mpwerrno
#endif
#else					/*MSL*/
#if defined(powerc)
	extern __signal_func_ptr (*_signal)(long sig,  __signal_func_ptr fun);
	extern long *_mpwerrno;
	#define GetMPWerrno() *_mpwerrno
#else
	#pragma segment Main
	extern __signal_func_ptr (_signal)(long sig, __signal_func_ptr fun);
	extern long _mpwerrno;
	#define GetMPWerrno() _mpwerrno
#endif
#endif  

#ifndef __MODENALIB__ /*plauger*/
_Sigfun *(signal)(int sig, _Sigfun *fun)
	{
		/*register*/ _Sigfun *(fun2);

		/* only SIGINT and SIGABRT might be used by MPW Shell */
		switch (sig) {
		case SIGABRT:
			sig = MPWSIGABRT;
			break;
		case SIGINT:
			sig = MPWSIGINT;
			break;
		}
		if (fun ==  SIG_DFL) {
			fun = MPWSIG_DFL;
		} else if (fun ==  SIG_ERR) {
			fun = MPWSIG_ERR;
		} else if (fun ==  SIG_IGN) {
			fun = MPWSIG_IGN;
		}
		fun2 = _signal(sig,fun);
		errno = GetMPWerrno();
		return(fun2);
	}
#else 		/*MSL*/
__signal_func_ptr (signal)(int sig, __signal_func_ptr fun)
	{
		/*register*/ __signal_func_ptr(fun2);

		/* only SIGINT and SIGABRT might be used by MPW Shell */
		switch (sig) {
		case SIGABRT:
			sig = MPWSIGABRT;
			break;
		case SIGINT:
			sig = MPWSIGINT;
			break;
		}
		if (fun ==  SIG_DFL) {
			fun = MPWSIG_DFL;
		} else if (fun ==  SIG_ERR) {
			fun = MPWSIG_ERR;
		} else if (fun ==  SIG_IGN) {
			fun = MPWSIG_IGN;
		}
		fun2 = _signal(sig,fun);
		errno = GetMPWerrno();
		return(fun2);
	}
#endif

#endif