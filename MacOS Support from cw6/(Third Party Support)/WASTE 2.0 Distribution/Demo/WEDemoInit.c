/*
 *	WASTE Demo Project:
 *	Initialization and Finalization
 *
 *	Copyright © 1993-2000 Marco Piovanelli
 *	All Rights Reserved
 *
 *	C port by John C. Daub
 *
 *	<mailto:waste@merzwaren.com>
 *	<http://www.merzwaren.com/waste/>
 */


//	Mac OS #includes

#ifndef __GESTALT__
#include <Gestalt.h>
#endif

#ifndef __TEXTSERVICES__
#include <TextServices.h>
#endif

//	WASTE Demo #includes

#ifndef __WEDEMO__
#include "WEDemo.h"
#endif

#ifndef __MEASURES__
#include "Measures.h"
#endif

#include "WEObjectHandlers.h"

//	static UPPs

static WENewObjectUPP		sPictureNewHandler = nil ;
static WEDisposeObjectUPP	sPictureDisposeHandler = nil ;
static WEDrawObjectUPP		sPictureDrawHandler = nil ;
static WENewObjectUPP		sSoundNewHandler = nil ;
static WEDrawObjectUPP		sSoundDrawHandler = nil ;
static WEClickObjectUPP		sSoundClickHandler = nil ;

static void CreateUnitResources ( )
{
	//	one-shot code for creating UNIT resources needed for string <-> measure conversions
	NewUnitResource ( kUnitPoint,		1 << 16,					"\p###' pt'", 		"\ppt" ) ;
	NewUnitResource ( kUnitCentimeter,	( 72.0 / 2.54 ) * 65536.0,	"\p##0.##' cm'",	"\pcm" ) ;
	NewUnitResource ( kUnitMillimeter,	( 72.0 / 25.4 ) * 65536.0,	"\p##0.#' mm'",		"\pmm" ) ;
	NewUnitResource ( kUnitInch,		72 << 16,					"\p##0.##' in'",	"\pin" ) ;
}

static Boolean CheckVersion ( SInt16 alertStringIndex, UInt32 installedVersion, UInt32 requiredVersion )
{
	Str255		banner ;
	Str255		explanation ;
	Str15		versionString ;
	SInt16		alertResult ;

	if ( installedVersion < requiredVersion )
	{
		GetIndString ( banner, kAlertStringsID, alertStringIndex ) ;
		GetIndString ( explanation, kAlertStringsID, alertStringIndex + 1 ) ;
		NumToVersionString ( installedVersion, versionString ) ;
		ReplaceParam ( explanation, versionString, 0 ) ;
		NumToVersionString ( requiredVersion, versionString ) ;
		ReplaceParam ( explanation, versionString, 1 ) ;
		StandardAlert ( kAlertStopAlert, banner, explanation, nil, & alertResult ) ;
		return true ;
	}

	return false ;
}

OSStatus Initialize ( void )
{
	SInt32		systemVersion ;
	OSStatus	err ;

#if ! TARGET_API_MAC_CARBON

	//	init the toolbox

	MaxApplZone ( ) ;
	InitGraf ( & qd . thePort ) ;
	InitFonts ( ) ;
	InitWindows ( ) ;
	InitMenus ( ) ;
	TEInit ( ) ;
	InitDialogs ( nil ) ;
	InitCursor ( ) ;
	FlushEvents ( everyEvent, 0 ) ;

#endif /* ! TARGET_API_MAC_CARBON */

	//	make sure we're using a recent version of the system software
	Gestalt ( gestaltSystemVersion, & systemVersion ) ;
	systemVersion = ( systemVersion << 16 ) | 0x8000 ;
	if ( CheckVersion ( 1, systemVersion, kMinSystemVersion ) )
	{
		return -1 ;
	}

	//	make sure we're using a recent version of WASTELib
	if ( CheckVersion ( 3, WEVersion ( ), kMinWASTEVersion ) )
	{
		return -1 ;
	}

#if ! TARGET_API_MAC_CARBON
	//	register this application with the TSM
	//	this is not needed for Carbon clients
	if ( ( err = InitTSMAwareApplication ( ) ) != noErr )
	{
		goto cleanup;
	}
#endif /* ! TARGET_API_MAC_CARBON */

	//	install default drag handlers
	if ( ( err = InstallDragHandlers ( ) ) != noErr )
	{
		goto cleanup ;
	}

	//	create UPPs for WASTE object handlers
	sPictureNewHandler = NewWENewObjectUPP ( HandleNewPicture ) ;
	sPictureDisposeHandler = NewWEDisposeObjectUPP ( HandleDisposePicture ) ;
	sPictureDrawHandler = NewWEDrawObjectUPP ( HandleDrawPicture ) ;
	sSoundNewHandler = NewWENewObjectUPP ( HandleNewSound ) ;
	sSoundDrawHandler = NewWEDrawObjectUPP ( HandleDrawSound ) ;
	sSoundClickHandler = NewWEClickObjectUPP ( HandleClickSound ) ;

	// install WASTE object handlers for pictures and sounds
	if ((err = WEInstallObjectHandler(kTypePicture, weNewHandler,
		(UniversalProcPtr) sPictureNewHandler, nil)) != noErr)
		goto cleanup;

	if ((err = WEInstallObjectHandler(kTypePicture, weDisposeHandler,
				(UniversalProcPtr) sPictureDisposeHandler, nil)) != noErr)
		goto cleanup;

	if ((err = WEInstallObjectHandler(kTypePicture, weDrawHandler,
				(UniversalProcPtr) sPictureDrawHandler, nil)) != noErr)
		goto cleanup;

	if ((err = WEInstallObjectHandler(kTypeSound, weNewHandler,
				(UniversalProcPtr) sSoundNewHandler, nil)) != noErr)
		goto cleanup;

	if ((err = WEInstallObjectHandler(kTypeSound, weDrawHandler,
				(UniversalProcPtr) sSoundDrawHandler, nil)) != noErr)
		goto cleanup;

	if ((err = WEInstallObjectHandler(kTypeSound, weClickHandler,
				(UniversalProcPtr) sSoundClickHandler, nil)) != noErr)
		goto cleanup;

	// perform other initialization chores

	if ( ( err = InstallEventHandlers( ) ) != noErr )
		goto cleanup;

	if ( ( err = InitializeMenus( ) ) != noErr )
		goto cleanup;

#if 0
	CreateUnitResources ( ) ;
#endif

	// clear result code
	err = noErr;

cleanup:
	if ( err != noErr )
	{
		ErrorAlert( err );
	}

	return err;
}

void Finalize ( void )
{
	// remove drag handlers

	RemoveDragHandlers ( ) ;

#if ! TARGET_API_MAC_CARBON
	// notify text services that we're closing down
	// this is not needed for Carbon clients
	CloseTSMAwareApplication ( ) ;
#endif /* ! TARGET_API_MAC_CARBON */

	//	remove WASTE object handlers
	WERemoveObjectHandler ( kTypePicture, weNewHandler, ( UniversalProcPtr ) sPictureNewHandler, nil ) ;
	WERemoveObjectHandler ( kTypePicture, weDisposeHandler, ( UniversalProcPtr ) sPictureDisposeHandler, nil ) ;
	WERemoveObjectHandler ( kTypePicture, weDrawHandler, ( UniversalProcPtr ) sPictureDrawHandler, nil ) ;
	WERemoveObjectHandler ( kTypeSound, weNewHandler, ( UniversalProcPtr ) sSoundNewHandler, nil ) ;
	WERemoveObjectHandler ( kTypeSound, weDrawHandler, ( UniversalProcPtr ) sSoundDrawHandler, nil ) ;
	WERemoveObjectHandler ( kTypeSound, weClickHandler, ( UniversalProcPtr ) sSoundClickHandler, nil ) ;

	//	get rid of UPPs for WASTE object handlers
	DisposeWENewObjectUPP ( sPictureNewHandler ) ;
	DisposeWEDisposeObjectUPP ( sPictureDisposeHandler ) ;
	DisposeWEDrawObjectUPP ( sPictureDrawHandler ) ;
	DisposeWENewObjectUPP ( sSoundNewHandler ) ;
	DisposeWEDrawObjectUPP ( sSoundDrawHandler ) ;
	DisposeWEClickObjectUPP ( sSoundClickHandler ) ;
}
